## components/metrics/Kconfig
```kconfig
menu "Metrics Configuration"

    config METRICS_ENABLE
        bool "Enable metrics emission over serial"
        default y
        help
            When enabled, emits structured JSON metric lines prefixed with ##M##
            to UART0. Disable to compile out all instrumentation.

    config METRICS_DEVICE_ID
        string "Device ID string"
        default "esp32-A"
        depends on METRICS_ENABLE
        help
            Short identifier embedded in every metric line as the "dev" field.
            Use distinct IDs when running two boards simultaneously.

endmenu
```

## main/Kconfig.projbuild
```kconfig
menu "WiFi Configuration"

    config ESP_WIFI_SSID
        string "WiFi SSID"
        default "myssid"
        help
            SSID (network name) for the example to connect to.

    config ESP_WIFI_PASSWORD
        string "WiFi Password"
        default "mypassword"
        help
            WiFi password (WPA or WPA2) for the example to use.

    config THINGSBOARD_MQTT_ACCESS_TOKEN
        string "ThingsBoard MQTT access token"
        default "myMqttAccessToken"
        help
            The access token from ThingsBoard

    choice ESP_WIFI_SAE_MODE
        prompt "WPA3 SAE mode selection"
        default ESP_WPA3_SAE_PWE_BOTH
        help
            Select mode for SAE as Hunt and Peck, H2E or both.
        config ESP_WPA3_SAE_PWE_HUNT_AND_PECK
            bool "HUNT AND PECK"
        config ESP_WPA3_SAE_PWE_HASH_TO_ELEMENT
            bool "H2E"
        config ESP_WPA3_SAE_PWE_BOTH
            bool "BOTH"
    endchoice

    config ESP_WIFI_PW_ID
        string "PASSWORD IDENTIFIER"
        depends on  ESP_WPA3_SAE_PWE_HASH_TO_ELEMENT|| ESP_WPA3_SAE_PWE_BOTH
        default ""
        help
            password identifier for SAE H2E

    config ESP_MAXIMUM_RETRY
        int "Maximum retry"
        default 5
        help
            Set the Maximum retry to avoid station reconnecting to the AP unlimited when the AP is really inexistent.

    choice ESP_WIFI_SCAN_AUTH_MODE_THRESHOLD
        prompt "WiFi Scan auth mode threshold"
        default ESP_WIFI_AUTH_WPA2_PSK
        help
            The weakest authmode to accept in the scan mode.
            This value defaults to ESP_WIFI_AUTH_WPA2_PSK incase password is present and ESP_WIFI_AUTH_OPEN is used.
            Please select ESP_WIFI_AUTH_WEP/ESP_WIFI_AUTH_WPA_PSK incase AP is operating in WEP/WPA mode.

        config ESP_WIFI_AUTH_OPEN
            bool "OPEN"
        config ESP_WIFI_AUTH_WEP
            bool "WEP"
        config ESP_WIFI_AUTH_WPA_PSK
            bool "WPA PSK"
        config ESP_WIFI_AUTH_WPA2_PSK
            bool "WPA2 PSK"
        config ESP_WIFI_AUTH_WPA_WPA2_PSK
            bool "WPA/WPA2 PSK"
        config ESP_WIFI_AUTH_WPA3_PSK
            bool "WPA3 PSK"
        config ESP_WIFI_AUTH_WPA2_WPA3_PSK
            bool "WPA2/WPA3 PSK"
        config ESP_WIFI_AUTH_WAPI_PSK
            bool "WAPI PSK"
    endchoice

endmenu

menu "OTA / Metrics Configuration"

    config OTA_POLL_INTERVAL_MS
        int "OTA poll interval (ms)"
        default 31000
        help
            How often the device polls the Lambda for firmware updates.

    config OTA_API_URL
        string "OTA API Gateway URL"
        default "https://kavm965brg.execute-api.us-east-1.amazonaws.com/check"
        help
            Full URL of the API Gateway check endpoint.

    config TELEMETRY_ENABLE
        bool "Enable MQTT/ThingsBoard telemetry"
        default n
        help
            When enabled, connects to ThingsBoard via MQTT and publishes LED
            states and firmware version. Disabled by default as ThingsBoard
            is being phased out. Code remains compilable either way.

    config OTA_FORCE_FULL
        bool "Force full-image OTA (skip delta even if available)"
        default n
        help
            When y, appends force_full=1 to every broker check URL, causing
            the Lambda to return a full-image URL regardless of patch
            availability. Used for Stage 2 full-image baseline experiments.
            The Lambda already supports this parameter; no cloud changes needed.

    config METRICS_OTA_PROGRESS
        bool "Emit ota_progress events during transfer (debug only)"
        depends on METRICS_ENABLE
        default n
        help
            Emits an ota_progress metric event every 128 KB of patch transfer.
            Distorts timing measurements due to UART overhead; NEVER enable
            during timed campaign runs. Useful only for debugging the OTA path.

    config OTA_TASK_STACK_SIZE
        int "OTA task stack size (bytes)"
        default 12288
        help
            Stack size in bytes for the ota_task. Emitted in the boot event as
            stack_size so the harness can compute stack_used_pct.

endmenu
```

## sdkconfig.defaults
```kconfig
CONFIG_ESPTOOLPY_FLASHSIZE_4MB=y
CONFIG_ESPTOOLPY_FLASHMODE_DIO=y
CONFIG_ESPTOOLPY_FLASHFREQ_40M=yCONFIG_PARTITION_TABLE_CUSTOM=y
CONFIG_PARTITION_TABLE_FILENAME="partitions.csv"
```
